## conf/layer.conf
```bitbake
# Append conf dir to BBPATH
BBPATH .= ":${LAYERDIR}"

# Append recipe dir to BBFILES
BBFILES += "${LAYERDIR}/recipes*/*/*.bb ${LAYERDIR}/recipes*/*/*.bbappend"

LAYERSERIES_COMPAT_meta-vscode = "kirkstone"

BBFILE_COLLECTIONS += "meta-vscode"
BBFILE_PRIORITY_meta-vscode = "1"
BBFILE_PATTERN_meta-vscode = "${LAYERDIR}"
```
